/* Core word list declarations. */

/* WARNING: This file is *only* meant to be included by builtin.c.
   It depends on internal declarations and definitions provided by that
   file and it is *not* designed to work correctly in any other
   context. */

#define _e4__BUILTIN_CORE_DECL()    \
    _e4__BUILTIN_PROC_FIRST(ABORT)  \
    _e4__BUILTIN_PROC_NF(ABORT_QUOTE, "ABORT\"",    \
        e4__F_COMPONLY | e4__F_IMMEDIATE)   \
    _e4__BUILTIN_THUNK(ABS) \
    _e4__BUILTIN_THUNK(ALIGN)   \
    _e4__BUILTIN_PROC(ALIGNED)  \
    _e4__BUILTIN_PROC(ALLOT)    \
    _e4__BUILTIN_PROC(AND)  \
    _e4__BUILTIN_USERVAR(BASE) \
    _e4__BUILTIN_PUN_F(BEGIN, HERE, e4__F_COMPONLY | e4__F_IMMEDIATE)   \
    _e4__BUILTIN_CONSTANT(BL, ' ')  \
    _e4__BUILTIN_THUNK_NF(BRACKET_CHAR, "[CHAR]",   \
            e4__F_IMMEDIATE | e4__F_COMPONLY)   \
    _e4__BUILTIN_THUNK_NF(BRACKET_TICK, "[']",  \
           e4__F_IMMEDIATE | e4__F_COMPONLY)   \
    _e4__BUILTIN_PROC_N(C_COMMA, "C,")  \
    _e4__BUILTIN_PROC_N(C_FETCH, "C@")  \
    _e4__BUILTIN_PROC_N(C_STORE, "C!")  \
    _e4__BUILTIN_THUNK(CELLS)   \
    _e4__BUILTIN_THUNK_N(CELL_PLUS, "CELL+")    \
    _e4__BUILTIN_PROC(CHAR) \
    _e4__BUILTIN_THUNK_N(CHAR_PLUS, "CHAR+")    \
    _e4__BUILTIN_THUNK(CHARS)   \
    _e4__BUILTIN_PROC_N(COLON, ":") \
    _e4__BUILTIN_PROC_N(COMMA, ",") \
    _e4__BUILTIN_PROC(CONSTANT) \
    _e4__BUILTIN_THUNK(COUNT)   \
    _e4__BUILTIN_PROC(CR)   \
    _e4__BUILTIN_PROC(CREATE)   \
    _e4__BUILTIN_THUNK(DECIMAL) \
    _e4__BUILTIN_PROC(DEPTH)    \
    _e4__BUILTIN_PROC_F(DO, e4__F_COMPONLY | e4__F_IMMEDIATE)   \
    _e4__BUILTIN_PROC_NF(DOES, "DOES>", e4__F_IMMEDIATE)    \
    _e4__BUILTIN_PROC_N(DOT, ".")    \
    _e4__BUILTIN_PROC_NF(DOT_QUOTE, ".\"", e4__F_IMMEDIATE) \
    _e4__BUILTIN_PROC(DROP) \
    _e4__BUILTIN_PROC(DUP)  \
    _e4__BUILTIN_PROC_F(ELSE, e4__F_COMPONLY | e4__F_IMMEDIATE) \
    _e4__BUILTIN_PROC(EMIT) \
    _e4__BUILTIN_PROC_N(ENVIRONMENT_QUERY, "ENVIRONMENT?")  \
    _e4__BUILTIN_PROC_N(EQUALS, "=")    \
    _e4__BUILTIN_PROC(EVALUATE) \
    _e4__BUILTIN_PROC(EXECUTE)  \
    _e4__BUILTIN_PROC_F(EXIT, e4__F_COMPONLY)   \
    _e4__BUILTIN_PROC_N(FETCH, "@") \
    _e4__BUILTIN_PROC(FILL) \
    _e4__BUILTIN_PROC_N(FM_SLASH_MOD, "FM/MOD") \
    _e4__BUILTIN_THUNK_N(GREATER_THAN, ">") \
    _e4__BUILTIN_USERVAR(HERE)  \
    _e4__BUILTIN_PROC(HOLD) \
    _e4__BUILTIN_ALIAS_F(I, R_FETCH, e4__F_COMPONLY)    \
    _e4__BUILTIN_PROC_F(IF, e4__F_COMPONLY | e4__F_IMMEDIATE)   \
    _e4__BUILTIN_PROC(IMMEDIATE)    \
    _e4__BUILTIN_PROC(INVERT)   \
    _e4__BUILTIN_PROC_F(J, e4__F_COMPONLY)  \
    _e4__BUILTIN_PROC(KEY)  \
    _e4__BUILTIN_PROC_F(LEAVE, e4__F_COMPONLY | e4__F_IMMEDIATE)    \
    _e4__BUILTIN_PROC_NF(LEFT_BRACKET, "[", e4__F_COMPONLY | e4__F_IMMEDIATE)\
    _e4__BUILTIN_PROC_N(LESS_NUMBER_SIGN, "<#") \
    _e4__BUILTIN_PROC_N(LESS_THAN, "<") \
    _e4__BUILTIN_PROC_F(LITERAL, e4__F_COMPONLY | e4__F_IMMEDIATE)  \
    _e4__BUILTIN_THUNK_F(LOOP, e4__F_COMPONLY | e4__F_IMMEDIATE)    \
    _e4__BUILTIN_PROC(LSHIFT)   \
    _e4__BUILTIN_PROC_N(M_STAR, "M*")   \
    _e4__BUILTIN_PROC(MAX)  \
    _e4__BUILTIN_PROC(MIN)  \
    _e4__BUILTIN_PROC_N(MINUS, "-") \
    _e4__BUILTIN_THUNK(MOD) \
    _e4__BUILTIN_PROC(MOVE) \
    _e4__BUILTIN_PROC(NEGATE)   \
    _e4__BUILTIN_PROC_N(NUMBER_SIGN, "#")   \
    _e4__BUILTIN_PROC_N(NUMBER_SIGN_GREATER, "#>")  \
    _e4__BUILTIN_PROC_N(NUMBER_SIGN_S, "#S")    \
    _e4__BUILTIN_THUNK_N(ONE_MINUS, "1-")   \
    _e4__BUILTIN_THUNK_N(ONE_PLUS, "1+")    \
    _e4__BUILTIN_PROC(OR)   \
    _e4__BUILTIN_PROC(OVER) \
    _e4__BUILTIN_THUNK_NF(PAREN, "(", e4__F_IMMEDIATE)  \
    _e4__BUILTIN_PROC_N(PLUS, "+")  \
    _e4__BUILTIN_PROC_NF(PLUS_LOOP, "+LOOP", e4__F_COMPONLY | e4__F_IMMEDIATE)\
    _e4__BUILTIN_THUNK_N(PLUS_STORE, "+!")  \
    _e4__BUILTIN_PROC_F(POSTPONE, e4__F_COMPONLY | e4__F_IMMEDIATE) \
    _e4__BUILTIN_THUNK_N(QUESTION_DUP, "?DUP")  \
    _e4__BUILTIN_PROC(QUIT) \
    _e4__BUILTIN_PROC_NF(R_FETCH, "R@", e4__F_COMPONLY) \
    _e4__BUILTIN_PROC_NF(R_FROM, "R>", e4__F_COMPONLY)  \
    _e4__BUILTIN_PROC_F(RECURSE, e4__F_COMPONLY | e4__F_IMMEDIATE)  \
    _e4__BUILTIN_PROC_F(REPEAT, e4__F_COMPONLY | e4__F_IMMEDIATE)   \
    _e4__BUILTIN_PROC_N(RIGHT_BRACKET, "]") \
    _e4__BUILTIN_PROC(ROT)  \
    _e4__BUILTIN_PROC(RSHIFT)   \
    _e4__BUILTIN_PROC_N(S_TO_D, "S>D")  \
    _e4__BUILTIN_PROC_NF(S_QUOTE, "S\"", e4__F_IMMEDIATE)   \
    _e4__BUILTIN_PROC_NF(SEMICOLON, ";", e4__F_COMPONLY | e4__F_IMMEDIATE)  \
    _e4__BUILTIN_PROC(SIGN) \
    _e4__BUILTIN_THUNK_N(SLASH, "/")    \
    _e4__BUILTIN_PROC_N(SLASH_MOD, "/MOD") \
    _e4__BUILTIN_PROC_N(SM_SLASH_REM, "SM/REM") \
    _e4__BUILTIN_PROC(SOURCE)   \
    _e4__BUILTIN_THUNK(SPACE)   \
    _e4__BUILTIN_THUNK(SPACES)  \
    _e4__BUILTIN_PROC_N(STAR, "*")  \
    _e4__BUILTIN_PROC_N(STAR_SLASH, "*/")   \
    _e4__BUILTIN_PROC_N(STAR_SLASH_MOD, "*/MOD")    \
    _e4__BUILTIN_USERVAR(STATE) \
    _e4__BUILTIN_PROC_N(STORE, "!") \
    _e4__BUILTIN_PROC(SWAP) \
    _e4__BUILTIN_PROC_F(THEN, e4__F_COMPONLY | e4__F_IMMEDIATE) \
    _e4__BUILTIN_PROC_N(TICK, "'")  \
    _e4__BUILTIN_PROC_N(TO_BODY, ">BODY")   \
    _e4__BUILTIN_USERVAR_N(TO_IN, ">IN")    \
    _e4__BUILTIN_PROC_N(TO_NUMBER, ">NUMBER")   \
    _e4__BUILTIN_PROC_NF(TO_R, ">R", e4__F_COMPONLY)    \
    _e4__BUILTIN_THUNK_N(TWO_DROP, "2DROP") \
    _e4__BUILTIN_THUNK_N(TWO_DUP, "2DUP")   \
    _e4__BUILTIN_THUNK_N(TWO_FETCH, "2@")   \
    _e4__BUILTIN_THUNK_N(TWO_OVER, "2OVER") \
    _e4__BUILTIN_PROC_N(TWO_SLASH, "2/")    \
    _e4__BUILTIN_PROC_N(TWO_STAR, "2*")     \
    _e4__BUILTIN_THUNK_N(TWO_STORE, "2!")   \
    _e4__BUILTIN_THUNK_N(TWO_SWAP, "2SWAP") \
    _e4__BUILTIN_PROC(TYPE) \
    _e4__BUILTIN_PROC_N(U_DOT, "U.")  \
    _e4__BUILTIN_PROC_N(U_LESS_THAN, "U<")  \
    _e4__BUILTIN_PROC_N(UM_STAR, "UM*") \
    _e4__BUILTIN_PROC_F(UNLOOP, e4__F_COMPONLY) \
    _e4__BUILTIN_PROC_F(UNTIL, e4__F_COMPONLY | e4__F_IMMEDIATE)    \
    _e4__BUILTIN_PROC(VARIABLE) \
    _e4__BUILTIN_THUNK_F(WHILE, e4__F_COMPONLY | e4__F_IMMEDIATE)   \
    _e4__BUILTIN_PROC(WORD) \
    _e4__BUILTIN_PROC(XOR)  \
    _e4__BUILTIN_THUNK_N(ZERO_EQUALS, "0=") \
    _e4__BUILTIN_THUNK_N(ZERO_LESS, "0<")

/* vim: set ft=c: */
